## Kconfig
```kconfig
# 2024 t0bybr

config ZMK_PIMORONI_PIM447
  bool "Pimoroni PIM447 Trackball support"
  select ZMK_MOUSE
  select I2C
  select GPIO
  help
    Enable driver for Pimoroni  Trackball.

if ZMK_PIMORONI_PIM447

  config ZMK_PIMORONI_PIM447_AUTOMOUSE_TIMEOUT_MS
    int "Amount of milliseconds the mouse layer will be active after using the trackball"
    default 400

  config ZMK_PIM447_BEHAVIORS
    bool "Enable Pimoroni PIM447 Trackball Actions behavior"
    depends on ZMK_PIMORONI_PIM447
    select ZMK_BEHAVIORS
    default y
    help
      Enable Pimoroni PIM447 Trackball behaviors.
  
# --- [여기에 새 설정 추가] ---
  config PIMORONI_PIM447_LOG_LEVEL_DBG
      bool "Enable debug log level for PIM447"
      depends on LOG_DEFAULT_LEVEL_DBG
      default y
  # ------------------------------
endif # ZMK_PIMORONI_PIM447
```
